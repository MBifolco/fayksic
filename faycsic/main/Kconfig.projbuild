## faycsic/main/Kconfig.projbuild
```kconfig
menu "Testing Configuration"
    config MOCK_MESSAGES
        bool "Use mock messages sent to fayksic"
        help
            Mock commands and jobs with will known signals to fakysic.

    config MOCK_NUM_CORES
        int "Number of ASIC cores to simulate"
        range 1 8
        default 1
endmenu
```
